#include "drv_GPS.hpp"
#include "drv_Uart8.hpp"
#include "Basic.hpp"
#include "FreeRTOS.h"
#include "task.h"
#include "SensorsBackend.hpp"

static const uint8_t ubloxInit[] = {
		0xb5, 0x62, 0x06, 0x24, 0x24, 0x00,  0x05, 0x00,  0x07, 0x03,  0,0,0,0,0,0,0,0,0,0,0,0,0,0,0,0,0,0,0,0,0,0,0,0,0,0,0,0,0,0,0,0,  0x5d, 0xc9,	//NAV5
		0xB5, 0x62, 0x06, 0x08, 0x06, 0x00, 0x64, 0x00, 0x01, 0x00, 0x01, 0x00, 0x7A, 0x12,             // set rate to 10Hz
		
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		0xB5, 0x62, 0x06, 0x01, 0x03, 0x00, 0x01, 0x07, 0x01, 0x13, 0x51,           // set PVT MSG rate
		
		//set baudrate to 115200
		0xB5 , 0x62 , 0x06 , 0x00 , 0x14 , 0x00 , 0x01 , 0x00 , 0x00 , 0x00 , 0xD0 , 0x08 , 0x00 , 0x00 , 0x00 , 0xC2 , 0x01 , 0x00 , 0x07 , 0x00 , 0x01 , 0x00 , 0x00 , 0x00 , 0x00 , 0x00 , 0xBE , 0x72 ,			
};

enum GPS_Scan_Operation
{
	//在指定波特率下发送初始化信息
	GPS_Scan_Baud9600 = 9600 ,
	GPS_Scan_Baud38400 = 38400 ,
	GPS_Scan_Baud115200 = 115200 ,
	
	//检查是否设置成功
	GPS_Check_Baud ,
	//在当前波特率下再次发送配置
	GPS_ResendConfig ,
	//GPS已检测存在
	GPS_Present ,
};

struct GPS_State_Machine
{
	uint32_t frame_datas_ind = 0;
	uint16_t frame_datas_length;
	uint8_t read_state = 0;	//0=
	uint8_t CK_A , CK_B;	//checksum
};
static inline void ResetRxStateMachine( GPS_State_Machine* state_machine )
{
	state_machine->read_state=state_machine->frame_datas_ind=0;
}
static inline uint16_t GPS_ParseByte( GPS_State_Machine* state_machine, uint8_t* frame_datas, uint8_t r_data )
{
	frame_datas[ state_machine->frame_datas_ind++ ] = r_data;
	switch( state_machine->read_state )
	{
		case 0:	//找包头
		{				
			if( state_machine->frame_datas_ind == 1 )
			{
				if( r_data != 0xb5 )
					state_machine->frame_datas_ind = 0;
			}
			else
			{
				if( r_data == 0x62 )	//header found
				{
					state_machine->read_state = 1;
					state_machine->frame_datas_ind = 0;
					state_machine->CK_A = state_machine->CK_B = 0;	//reset checksum
				}		
				else
					state_machine->frame_datas_ind = 0;
			}	
			break;
		}
		case 1:	//读Class ID和包长度
		{
			state_machine->CK_A += r_data;
			state_machine->CK_B += state_machine->CK_A;
			if( state_machine->frame_datas_ind == 4 )
			{
				state_machine->frame_datas_length = (*(unsigned short*)&frame_datas[2]) + 4;
				if( state_machine->frame_datas_length > 4 && state_machine->frame_datas_length < 150 )
					state_machine->read_state = 2;						
				else
					ResetRxStateMachine(state_machine);
			}
			break;
		}
		case 2:	//读包内容
		{
			state_machine->CK_A += r_data;
			state_machine->CK_B += state_machine->CK_A;
			
			if( state_machine->frame_datas_ind == state_machine->frame_datas_length )
			{
				//payload read completed
				state_machine->read_state = 3;
			}
			break;
		}
		case 3://校验
		{
			if( state_machine->frame_datas_ind == state_machine->frame_datas_length + 1 )
			{
				if( r_data != state_machine->CK_A )
					ResetRxStateMachine(state_machine);
			}
			else
			{
				ResetRxStateMachine(state_machine);
				if( r_data == state_machine->CK_B )
					return state_machine->frame_datas_length;				
			}
		}
	}
	return 0;
}

static void GPS_Server(void* pvParameters)
{
	//GPS识别状态
	GPS_Scan_Operation current_GPS_Operation = GPS_Scan_Baud9600;
	//数据读取状态机
	__attribute__((aligned(4))) uint8_t frame_datas[150];
	//上次更新时间
	TIME last_update_time;
	
GPS_CheckBaud:
	while(1)
	{
		//更改指定波特率
		SetBaudRate_Uart8( current_GPS_Operation, 3, 0.1 );
		//发送配置
		Write_Uart8( ubloxInit, sizeof(ubloxInit), 3, 0.2 );
		switch(current_GPS_Operation)
		{
			case GPS_Scan_Baud9600:
				current_GPS_Operation = GPS_Scan_Baud38400;
				break;
			case GPS_Scan_Baud38400:
				current_GPS_Operation = GPS_Scan_Baud115200;
				break;
			default:
			case GPS_Scan_Baud115200:
				current_GPS_Operation = GPS_Scan_Baud9600;
				break;
		}
		
		//更改波特率
		SetBaudRate_Uart8( 115200, 3, 0.1 );
		//清空接收缓冲区准备接收数据
		ResetRx_Uart8(0.1);
		GPS_State_Machine gps_state;
		ResetRxStateMachine(&gps_state);
		TIME RxChkStartTime = TIME::now();
		while( RxChkStartTime.get_pass_time() < 2 )
		{
			uint8_t r_data;
			if( Read_Uart8( &r_data, 1, 0.5, 0.1 ) )
			{
				uint16_t pack_length = GPS_ParseByte( &gps_state, frame_datas, r_data );
				if( pack_length )
				{
					if( frame_datas[0]==0x01 && frame_datas[1]==0x07 )
					{
						goto GPS_Present;
					}
				}
			}
		}
	}
	
GPS_Present:
	//识别到gps
	//再次发送配置
	Write_Uart8( ubloxInit, sizeof(ubloxInit), 3, 0.2 );
	
	//注册传感器
	PositionSensorRegister( default_gps_sensor_index , \
													Position_Sensor_Type_GlobalPositioning , \
													Position_Sensor_DataType_sv_xy , \
													Position_Sensor_frame_ENU , \
													0.1 , //延时
													30 , //xy信任度
													30 //z信任度
												);
	
	//gps状态
	bool gps_available = false;
	bool z_available = false;
	TIME GPS_stable_start_time(false);
	
	//清空接收缓冲区准备接收数据
	ResetRx_Uart8(0.1);
	GPS_State_Machine gps_state;
	ResetRxStateMachine(&gps_state);
	last_update_time = TIME::now();
	while(1)
	{
		uint8_t r_data;
		if( Read_Uart8( &r_data, 1, 2, 0.1 ) )
		{
			uint16_t pack_length = GPS_ParseByte( &gps_state, frame_datas, r_data );
			if( pack_length )
			{
				if( frame_datas[0]==0x01 && frame_datas[1]==0x07 )
				{
					last_update_time = TIME::now();
					struct UBX_NAV_PVT_Pack
					{
						uint8_t CLASS;
						uint8_t ID;
						uint16_t length;
						
						uint32_t iTOW;
						uint16_t y;
						uint8_t month;
						uint8_t day;
						uint8_t hour;
						uint8_t min;
						uint8_t sec;
						uint8_t valid;
						uint32_t t_Acc;
						int32_t nano;
						uint8_t fix_type;
						uint8_t flags;
						uint8_t flags2;
						uint8_t numSV;
						int32_t lon;
						int32_t lat;
						int32_t height;
						int32_t hMSL;
						uint32_t hAcc;
						uint32_t vAcc;
						int32_t velN;
						int32_t velE;
						int32_t velD;
						int32_t gSpeed;
						int32_t headMot;
						uint32_t sAcc;
						uint32_t headAcc;
						uint16_t pDOP;
						uint8_t res1[6];
						int32_t headVeh;
						uint8_t res2[4];
					}__attribute__((packed));
					UBX_NAV_PVT_Pack* pack = (UBX_NAV_PVT_Pack*)frame_datas;
					
//					vector3<double> velocity;						
//						vector3<double> position_Global;
//						PositionSensorChangeDataType( default_gps_sensor_index, Position_Sensor_DataType_sv_xy );	
//						PositionSensorUpdatePositionGlobalVel( default_gps_sensor_index, position_Global , velocity , true , 0.15f );
//					continue;
					
					if( ((pack->flags & 1) == 1) && (pack->fix_type == 0x03) && (pack->numSV >= 5) )
					{
						if( gps_available == false )
						{
							if( pack->hAcc < 2500 )
							{
								if( GPS_stable_start_time.is_valid() == false )
									GPS_stable_start_time = TIME::now();
								else if( GPS_stable_start_time.get_pass_time() > 3.0f )
								{
									gps_available = true;
									GPS_stable_start_time.set_invalid();
								}
							}
							else
								GPS_stable_start_time.set_invalid();
						}
						else
						{
							if( pack->hAcc > 3500 )
								gps_available = z_available = false;
						}
						
					}
					else
					{
						gps_available = z_available = false;
						GPS_stable_start_time.set_invalid();
					}
					
					if( gps_available )
					{
						if( z_available )
						{
							if( pack->vAcc > 5500 )
								z_available = false;
						}
						else
						{
							if( pack->vAcc < 3800 )
								z_available = true;
						}
						
						vector3<double> velocity;
						velocity.y = pack->velN * 0.1;	//North
						velocity.x = pack->velE * 0.1;	//East
						velocity.z = -pack->velD * 0.1;	//Up
						
						vector3<double> position_Global;
						position_Global.x = pack->lat * 1e-7;
						position_Global.y = pack->lon * 1e-7;
						position_Global.z = pack->hMSL * 1e-1;
//										if( gps->available == false && available == true )
//											position_Global.z = pack->hMSL * 1e-1;
//										else
//											position_Global.z = gps->position.z + get_pass_time( gps->last_update_time )*velocity.z;
						
						if( z_available )
							PositionSensorChangeDataType( default_gps_sensor_index, Position_Sensor_DataType_sv_xyz );
						else
							PositionSensorChangeDataType( default_gps_sensor_index, Position_Sensor_DataType_sv_xy );
						double xy_trustD = pack->hAcc * 0.01 * 0.2;
						double z_trustD = pack->vAcc * 0.01;
						PositionSensorUpdatePositionGlobalVel( default_gps_sensor_index, position_Global, velocity, true, 0.2, xy_trustD, z_trustD );
													
					}
					else
						PositionSensorSetInavailable( default_gps_sensor_index );
				}
			}
			
			if( last_update_time.get_pass_time() > 2 )
			{	//接收不到数据
				PositionSensorUnRegister( default_gps_sensor_index );
				goto GPS_CheckBaud;
			}
		}
		else
		{	//接收不到数据
			PositionSensorUnRegister( default_gps_sensor_index );
			goto GPS_CheckBaud;
		}
	}
}

void init_drv_GPS()
{
	xTaskCreate( GPS_Server, "GPS", 1024, NULL, SysPriority_ExtSensor, NULL);
}